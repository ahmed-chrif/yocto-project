## meta-chrif-bsp/wic/sdimage-rpi02w-var.wks
```
# Raspberry Pi Zero 2 W
# p1 boot (FAT) | p2 root (squashfs, immutable) | p3 var (btrfs)

part /boot --source bootimg-partition --ondisk mmcblk0 --fstype=vfat --label boot --active --align 4096 --size 128
part / --source rootfs --ondisk mmcblk0 --fstype=squashfs --label rootfs --align 4096
part /var --source rawcopy --sourceparams="file=chrif-image-var-raspberrypi0-2w-64.btrfs" --ondisk mmcblk0 --fstype=btrfs --label var --align 4096 --size 512
```

## meta-chrif-distro/conf/layer.conf
```bitbake
BBPATH .= ":${LAYERDIR}"

BBFILES += "${LAYERDIR}/recipes-*/*/*.bb \
            ${LAYERDIR}/recipes-*/*/*.bbappend \
            ${LAYERDIR}/recipes-*/*/*/*.bb \
            ${LAYERDIR}/recipes-*/*/*/*.bbappend"

BBFILE_COLLECTIONS += "chrif-distro"
BBFILE_PATTERN_chrif-distro = "^${LAYERDIR}/"
BBFILE_PRIORITY_chrif-distro = "10"

LAYERVERSION_chrif-distro = "1"
LAYERSERIES_COMPAT_chrif-distro = "scarthgap styhead walnasdf"
```

## meta-yfs-bsp/conf/machine/chrif-rpi02.conf
```bitbake
require conf/machine/include/raspberrpi0-2w-64conf
MACHINE_FEATURES = ""
MACHINE_EXTRA_RRECOMMENDS = ""
MACHINE_EXTRA_RDEPENDS = ""

RPI_USE_U_BOOT = "1"
ENABLE_UART = "1"
ENABLE_I2C = "1"
KERNEL_DEVICETREE = "\
    broadcom/bcm2710-rpi-zero-2.dtb \
    overlays\overlay_map.dtb "
```
