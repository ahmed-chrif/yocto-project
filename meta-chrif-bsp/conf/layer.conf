## meta-chrif-bsp/conf/layer.conf
```bitbake
# We have a conf and classes directory, add to BBPATH
BBPATH .= ":${LAYERDIR}"

# We have recipes-* directories, add to BBFILES
BBFILES += "${LAYERDIR}/recipes-*/*/*.bb \
            ${LAYERDIR}/recipes-*/*/*.bbappend"

BBFILE_COLLECTIONS += "meta-chrif-bsp"
BBFILE_PATTERN_meta-chrif-bsp = "^${LAYERDIR}/"
BBFILE_PRIORITY_meta-chrif-bsp = "6"

LAYERDEPENDS_meta-chrif-bsp = "core"
LAYERSERIES_COMPAT_meta-chrif-bsp = "scarthgap"
```

## meta-chrif/conf/layer.conf
```bitbake
# We have a conf and classes directory, add to BBPATH
BBPATH .= ":${LAYERDIR}"

# We have recipes-* directories, add to BBFILES
BBFILES += "${LAYERDIR}/recipes-*/*/*.bb \
            ${LAYERDIR}/recipes-*/*/*.bbappend"

BBFILE_COLLECTIONS += "meta-chrif"
BBFILE_PATTERN_meta-chrif = "^${LAYERDIR}/"
BBFILE_PRIORITY_meta-chrif = "6"

LAYERDEPENDS_meta-chrif = "core"
LAYERSERIES_COMPAT_meta-chrif = "scarthgap"
```
